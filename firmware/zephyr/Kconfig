## firmware/zephyr/Kconfig
```kconfig
mainmenu "Invisible Keyboard Firmware"

source "Kconfig.zephyr"

choice IKB_HAND
	prompt "Physical hand controlled by this build"
	default IKB_HAND_LEFT

config IKB_HAND_LEFT
	bool "Left hand"

config IKB_HAND_RIGHT
	bool "Right hand"

endchoice

config IKB_CONTROLLER_ID
	string "Provisioned controller identity"
	default ""
	help
	  Exact UTF-8 hands.controller_id value used by the host acquisition
	  manifest. The firmware places SHA-256 of these bytes on the wire.
```

## firmware/zephyr/west.yml
```yaml
manifest:
  version: "1.2"

  remotes:
    - name: upstream
      url-base: https://github.com/zephyrproject-rtos

  projects:
    - name: zephyr
      remote: upstream
      revision: 684c9e8f32e4373a21098559f748f06915f950c9
      import:
        name-allowlist:
          - cmsis_6
          - hal_nordic

  self:
    path: application
```
